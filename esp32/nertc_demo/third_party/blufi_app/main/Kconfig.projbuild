## esp32/nertc_demo/third_party/blufi_app/main/Kconfig.projbuild
```kconfig
menu "YunXin config"

choice BOARD_TYPE
    prompt "Board Type"
    default BOARD_TYPE_ZUOWEI
    help
        Board type. 开发板类型
    config BOARD_TYPE_ZHENGCHEN_QUDOU
        bool "征辰科技-趣逗"
        depends on IDF_TARGET_ESP32S3
    config BOARD_TYPE_ZUOWEI
        bool "佐为"
        depends on IDF_TARGET_ESP32S3
endchoice

endmenu
```
